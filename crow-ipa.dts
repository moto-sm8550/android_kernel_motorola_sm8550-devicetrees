/dts-v1/;
/plugin/;

#include <dt-bindings/interrupt-controller/arm-gic.h>
#include <dt-bindings/soc/qcom,ipcc.h>
#include <dt-bindings/interconnect/qcom,crow.h>
#include <dt-bindings/clock/qcom,gcc-crow.h>
#include <dt-bindings/clock/qcom,rpmh.h>
#include "kalama-ipa.dtsi"

/ {
	model = "Qualcomm Technologies, Inc. Crow SoC";
        compatible = "qcom,crow";
        qcom,msm-id = <608 0x10000>;
	qcom,board-id = <0 0>;
};
