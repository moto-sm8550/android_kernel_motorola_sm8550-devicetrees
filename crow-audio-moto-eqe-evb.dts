/*
   This file is derivated from crow-audio-mtp.dts
 */

/dts-v1/;
/plugin/;

#include "crow-audio-moto-eqe-common.dtsi"
 / {
	model = "eqe";
	compatible = "qcom,crow-idp", "qcom,crow", "qcom,idp", "mot,eqe";
	qcom,msm-id = <608 0x10000>;
	qcom,board-id = <0x41 0x9000>;
};
