/*
   This file is derivated from kalama-audio-mtp.dts
 */

/dts-v1/;
/plugin/;

#include "kalama-audio-moto-ctwo-common.dtsi"
 / {
	model = "ctwo";
	compatible = "qcom,kalama-mtp", "qcom,kalama", "qcom,mtp", "mot,ctwo";
	qcom,msm-id = <519 0x10000>, <536 0x10000>;
	qcom,board-id = <0x4b 0x9000>;
};
