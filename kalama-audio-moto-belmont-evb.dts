/* Copyright (c) 2022, The Linux Foundation. All rights reserved.
 *
 * This program is free software; you can redistribute it and/or modify
 * it under the terms of the GNU General Public License version 2 and
 * only version 2 as published by the Free Software Foundation.
 *
 * This program is distributed in the hope that it will be useful,
 * but WITHOUT ANY WARRANTY; without even the implied warranty of
 * MERCHANTABILITY or FITNESS FOR A PARTICULAR PURPOSE.  See the
 * GNU General Public License for more details.
 */

/dts-v1/;
/plugin/;

#include "kalama-audio-moto-belmont-common.dtsi"

/ {
	model = "belmont";
	compatible = "qcom,kalama-mtp", "qcom,kalama", "qcom,mtp", "mot,belmont";
	qcom,msm-id = <519 0x20000>, <536 0x20000>; /* kalama-v2 only */
	qcom,board-id = <0x48 0x9000>;
};

&wcd938x_codec {
    status = "disabled";
};
