/dts-v1/;
/plugin/;

#include <dt-bindings/interrupt-controller/arm-gic.h>
#include <dt-bindings/clock/qcom,rpmcc.h>
#include <dt-bindings/clock/qcom,dispcc-khaje.h>
#include <dt-bindings/clock/qcom,gcc-khaje.h>
#include <dt-bindings/clock/qcom,gpucc-khaje.h>
#include <dt-bindings/spmi/spmi.h>
#include <dt-bindings/regulator/qcom,rpmh-regulator-levels.h>
#include <dt-bindings/interconnect/qcom,bengal.h>
#include <dt-bindings/soc/qcom,dcc_v2.h>

#include "khaje-gpu.dtsi"

/ {
	model = "Qualcomm Technologies, Inc. Khaje SoC";
	compatible = "qcom,khaje-qrd", "qcom,khaje", "qcom,qrd",
			"qcom,khaje-atp", "qcom,atp", "qcom,khajeq-idp",
			"qcom,khaje-idp", "qcom,idp", "qcom,khajeq-qrd",
			"qcom,khajep-atp", "qcom,khajep", "qcom,khajep-idp",
			"qcom,khajep-qrd",  "qcom,khajeq-atp", "qcom,khajeq";

	qcom,msm-id = <518 0x10000>, <561 0x10000>, <562 0x10000>;
	qcom,board-id = <0 0>, <0x10022 0>, <0x10122 0>, <33 0>, <0x10222 0>,
			<0x1010022 0>, <0x1000B 0>, <0x1010B 0>, <0x2010B 0>;
};

